## conf/layer.conf
```bitbake
# We have a conf and classes directory, append to BBPATH
BBPATH .= ":${LAYERDIR}"

# We have a recipes directory, add to BBFILES
BBFILES += "${LAYERDIR}/recipes-*/*/*.bb \
            ${LAYERDIR}/recipes-*/*/*.bbappend"

BBFILE_COLLECTIONS += "meta-bsp-kratos"
BBFILE_PATTERN_meta-bsp-kratos := "^${LAYERDIR}/"
BBFILE_PRIORITY_meta-bsp-kratos = "5"
LAYERSERIES_COMPAT_meta-bsp-kratos = "kirkstone"

FILESEXTRAPATHS:prepend := "${LAYERDIR}/recipes-kernel/linux/files:"

CORE_IMAGE_EXTRA_INSTALL += " bridge-utils notes mdiotools releaselist releasemanaged version"
CORE_IMAGE_EXTRA_INSTALL += " stress rt-tests iperf3 netperf"
CORE_IMAGE_EXTRA_INSTALL += " openssh gdb gdbserver iptables"
LINUX_KERNEL_TYPE = "preempt-rt"
CORE_IMAGE_EXTRA_INSTALL += " tcpdump netsniff-ng ethtool"
CORE_IMAGE_EXTRA_INSTALL += " systemd-ethtool maintenance bit mtd-utils static-ip-config spidevtest jsoncpp jsoncpp-dev nano bridgeactivation kratos-station-pm-module-load"
CORE_IMAGE_EXTRA_INSTALL += " i2c-tools"
TOOLCHAIN_TARGET_TASK:append = " jsoncpp-dev"
```
